// Copyright 2021 Manna Harbour
// https://github.com/manna-harbour/miryoku

#include "../miryoku/custom_config.h"
#include "../miryoku/mapping/42/corne.h"
#include "../miryoku/miryoku.dtsi"
#include <dt-bindings/zmk/outputs.h>
/ {
    combos {
        compatible = "zmk,combos";
        combo_out_tog {
            timeout-ms = <50>;
            key-positions = <0 1>;
            bindings = <&out OUT_TOG>;
            layers = <0>;
        };
    };
};
